/*
 * File Role    : Rendering UI pada OLED SSD1309 menggunakan u8g2, termasuk splash
 *                animation dan layar utama yang menampilkan telemetri MPPT.
 * Dependencies : main.h (handle I2C, data sensor, status charging), u8g2 library.
 * Fungsi inti  : lcd_init(), DisplayRabbitAnimation(), lcd_print_unit(), lcd_main_display().
 */
#include "main.h"

char lcd_buff[16];

static const uint8_t PV_CHAR[] = {
		0xfe,0x00,0x01,0x01,0x6d,0x01,0x6d,0x01,
		0x01,0x01,0x6d,0x01,0x6d,0x01,0x01,0x01,
		0x6d,0x01,0x6d,0x01,0x01,0x01,0xfe,0x00};
static const uint8_t MPPT_CHAR[] = {
		0xfe,0x7f,0x01,0xc0,0x55,0xb0,0x01,0x88,
		0x7d,0x86,0x01,0x81,0x81,0x80,0x61,0xaa,
		0x11,0x80,0x0d,0xbe,0x03,0x80,0xfe,0x7f};
static const uint8_t BAT_CHAR[] = {
		0x38,0x0e,0x28,0x0a,0xc6,0x31,0x01,0x40,
		0x01,0x40,0x11,0x40,0x39,0x4e,0x11,0x40,
		0x01,0x40,0x01,0x40,0x01,0x40,0xfe,0x3f};
static const uint8_t image_hourglass2_bits[] = {
		0x00,0x00,0x00,0xe0,0xff,0x0f,0x20,0x00,
		0x08,0xc0,0xff,0x07,0x80,0x00,0x02,0x80,
		0x00,0x02,0x80,0x00,0x02,0x80,0x7c,0x02,
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		0x00,0x08,0xe0,0xff,0x0f,0x00,0x00,0x00};

// ======================RABBIT ANIMATION================== //

static const uint8_t RABBIT1[] = {0x00,0x00,0x00,0x00,0x00,0x00,0x00,0x00,0x00,0x00,0x00,0x00,0x00,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0x00,0x00};
static const uint8_t RABBIT2[] = {0x00,0x00,0x00,0x00,0x00,0x00,0x00,0x00,0x00,0x00,0x00,0x00,0x00,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0x00,0x00};
static const uint8_t RABBIT3[] = {0x00,0x00,0x00,0x00,0x00,0x00,0x00,0x00,0x00,0x00,0x00,0x00,0x00,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0x00,0x00};
static const uint8_t RABBIT4[] = {0x00,0x00,0x00,0x00,0x00,0x00,0x00,0x00,0x00,0x00,0x00,0x00,0x00,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0x00,0x00};
static const uint8_t RABBIT5[] = {0x00,0x00,0x00,0x00,0x00,0x00,0x00,0x00,0x00,0x00,0x00,0x00,0x00,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0x00,0x00};
static const uint8_t RABBIT6[] = {0x00,0x00,0x00,0x00,0x00,0x00,0x00,0x00,0x00,0x00,0x00,0x00,0x00,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0x00,0x00};

int Layer_1_copy_x = 41;

uint8_t u8x8_gpio_and_delay(u8x8_t *u8x8, uint8_t msg, uint8_t arg_int, void *arg_ptr)
{
	switch(msg)
	{
		case U8X8_MSG_DELAY_MILLI:
			HAL_Delay(arg_int);
			break;
	}
	return 1;
}

uint8_t u8x8_i2c(u8x8_t *u8x8, uint8_t msg, uint8_t arg_int, void *arg_ptr)
{
	static uint8_t buffer[32];		/* u8g2/u8x8 will never send more than 32 bytes between START_TRANSFER and END_TRANSFER */
	static uint8_t buf_idx;
	uint8_t *data;
	switch(msg)
	{
		case U8X8_MSG_BYTE_SEND:
			data = (uint8_t *)arg_ptr;
			while( arg_int > 0 )
			{
				if (buf_idx < sizeof(buffer)) {
					buffer[buf_idx++] = *data;
				}
				data++;
				arg_int--;
			}
			break;
		case U8X8_MSG_BYTE_START_TRANSFER:
			buf_idx = 0;
			break;
		case U8X8_MSG_BYTE_END_TRANSFER:
			HAL_I2C_Master_Transmit(&hi2c1, 0x78, buffer, buf_idx, 1000);
			break;
		default:
			return 0;
	}
	return 1;
}

void lcd_init() {
	u8g2_Setup_ssd1309_i2c_128x64_noname0_f(&display, U8G2_R0, u8x8_i2c, u8x8_gpio_and_delay);
	HAL_Delay(10);
	u8g2_InitDisplay(&display);
	HAL_Delay(10);
	u8g2_SetPowerSave(&display, 0);

	u8g2_DrawFrame(&display, 0, 0, 128, 64);
	/*
	u8g2_SetFont(&display, u8g2_font_timR10_tr);
	u8g2_DrawStr(&display, 14, 20, "INTERLEAVED");
	u8g2_DrawStr(&display, 41, 37, "BOOST");
	u8g2_DrawStr(&display, 21, 54, "CONVERTER");
	*/
	u8g2_SetFontMode(&display, 1);

	u8g2_SetFont(&display, u8g2_font_haxrcorp4089_tr);
	u8g2_DrawStr(&display, 3, 10, "CAPSTONE PROJECT");

	u8g2_DrawStr(&display, 3, 20, "MPPT Interleaved Boost");

	u8g2_SetFont(&display, u8g2_font_6x13B_tr);
	u8g2_DrawStr(&display, Layer_1_copy_x, 60, "Project Athena");

	u8g2_SetFont(&display, u8g2_font_4x6_tr);
	u8g2_DrawStr(&display, 3, 58, "^_^");

	u8g2_DrawLine(&display, 16, 56, 37, 56);

	u8g2_DrawXBM(&display, 104, 0, 24, 24, image_hourglass2_bits);

	u8g2_SendBuffer(&display);

	HAL_Delay(1500);

	// u8g2_ClearDisplay(&display);
    u8g2_SetFont(&display, u8g2_font_6x12_tr);
    u8g2_DrawStr(&display, 59, 57, "starting...");
}

// misalnya array pointer ke bitmap
const uint8_t* rabbitFrames[6] = {RABBIT1, RABBIT2, RABBIT3, RABBIT4, RABBIT5, RABBIT6};

void DisplayRabbitAnimation(void) {
    for (int iter = 0; iter < 4; iter++) {          // 10 kali iterasi
        for (int frame = 0; frame < 6; frame++) {    // 6 frame per iterasi
            u8g2_ClearBuffer(&display);
            u8g2_SetBitmapMode(&display, 1);
            u8g2_SetFontMode(&display, 1);

            u8g2_DrawXBM(&display, 0, 0, 64, 64, rabbitFrames[frame]);
            u8g2_SetFont(&display, u8g2_font_6x12_tr);
            u8g2_DrawStr(&display, 61, 27, "bunny");
            u8g2_DrawStr(&display, 61, 38, "is running");
            u8g2_DrawStr(&display, 61, 48, "...");

            u8g2_SendBuffer(&display);

            HAL_Delay(25);

        }
    }
}

//Menyederhanakan perintah LCD
void lcd_print_unit(uint8_t col, uint8_t row, uint16_t data, UnitLcd_e unit) {
	switch (unit) {
		case UNIT_VOLTAGE: // Print unit Tegangan
			sprintf(lcd_buff, "%u.%01uV ", data / 10, data % 10);
			break;
		case UNIT_CURRENT: // Print unit Arus
			sprintf(lcd_buff, "%u.%01uA ", data / 10, data % 10);
			break;
		case UNIT_TEMPERATURE: // Print unit Suhu
			sprintf(lcd_buff, "%d%cC ", data, 0xB0);
			break;
		case UNIT_PERCENTAGE: // Print unit Persen
			sprintf(lcd_buff, "%d%%", data);
			break;
		case UNIT_POWER: // Print unit Daya
			sprintf(lcd_buff, "%u.%01uW ", data / 100, data % 100);
			break;
		default:
			break;
	}
	u8g2_DrawStr(&display, col, row, lcd_buff);
	//memset(lcd_buff, 0, sizeof(lcd_buff));
}

void lcd_main_display() {
	u8g2_ClearBuffer(&display);
	u8g2_DrawFrame(&display, 0, 0, 128, 64);

	u8g2_DrawXBM(&display, 10, 2, 15, 12, PV_CHAR);
	u8g2_DrawXBM(&display, 56, 2, 16, 12, MPPT_CHAR);
	u8g2_DrawXBM(&display, 103, 2, 15, 12, BAT_CHAR);

	u8g2_SetFont(&display, u8g2_font_6x10_tf);

	lcd_print_unit(2, 23, dis_voltage_pv, UNIT_VOLTAGE);
	lcd_print_unit(97, 23, dis_voltage_bat, UNIT_VOLTAGE);
	lcd_print_unit(2, 34, dis_current_pv, UNIT_CURRENT);
	lcd_print_unit(97, 34, dis_current_bat, UNIT_CURRENT);
	lcd_print_unit(53, 23, dis_temperature, UNIT_TEMPERATURE);
	lcd_print_unit(53, 34, duty_percent, UNIT_PERCENTAGE);
	lcd_print_unit(2, 45, dis_power_pv, UNIT_POWER);
	lcd_print_unit(91, 45, dis_power_bat, UNIT_POWER);
	lcd_print_unit(97, 56, soc_battery, UNIT_PERCENTAGE);


	if(flag_charging_Bulk) {
		u8g2_DrawStr(&display, 2, 56, "MPPT MODE >.<");
	} else if (flag_charging_CV) {
		u8g2_DrawStr(&display, 2, 56, "ABSORP/CV MODE");
	} else if (flag_charging_FLOAT) {
		u8g2_DrawStr(&display, 2, 56, "FLOAT MODE ^o^");
	} else {
		u8g2_DrawStr(&display, 2, 56, "STANDBY (^///^)");
	}



	u8g2_SendBuffer(&display);
}
